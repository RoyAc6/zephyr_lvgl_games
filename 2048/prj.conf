## CMakeLists.txt
```
# SPDX-License-Identifier: Apache-2.0

cmake_minimum_required(VERSION 3.20.0)

if(CONFIG_BOARD_FRDM_MCXN947)
    set(SHIELD lcd_par_s035_8080)
endif()

find_package(Zephyr REQUIRED HINTS $ENV{ZEPHYR_BASE})
project(2048)

FILE(GLOB app_sources src/*.c)
target_sources(app PRIVATE ${app_sources})
target_include_directories(app PRIVATE inc)
```

## Kconfig
```
menu "2048 Game Configuration"

config 2048_USE_BUTTONS_TO_MOVE
    bool "Enable on-screen arrow buttons for movement"
    default n
    help
      If enabled, the game will render transparent arrow buttons
      along the edges of the grid for tap‑based movement.
      If disabled, movement is only via swipe gestures.

endmenu

source "Kconfig.zephyr"
```

## prj.conf
```kconfig
CONFIG_LV_Z_MEM_POOL_SIZE=16384
CONFIG_MAIN_STACK_SIZE=8192

CONFIG_DISPLAY=y
CONFIG_INPUT=y

CONFIG_LVGL=y
CONFIG_LV_FONT_MONTSERRAT_22=y

CONFIG_TEST_RANDOM_GENERATOR=y

# Enable our on‑screen arrow buttons
CONFIG_2048_USE_BUTTONS_TO_MOVE=n
```

## src/main.c
```c
/*
 * src/main.c - 2048 game on Zephyr RTOS for lcd_par_s035_8080 display
 * with LVGL grid, swipe/buttons input, animation, and full game logic
 *
 * Ensure in prj.conf:
 *   CONFIG_LVGL=y
 *   CONFIG_LVGL_DISPLAY=y
 *   CONFIG_GPIO=y
 *   CONFIG_RANDOM_NUMBER_GENERATOR=y
 *   CONFIG_2048_USE_BUTTONS_TO_MOVE=y  (optional)
 */

 #include "config.h"
 #include "game.h"
 #include "ui.h"
 #include "input.h"
 
 #include <zephyr/device.h>
 #include <zephyr/devicetree.h>
 #include <zephyr/drivers/display.h>
 #include <zephyr/kernel.h>
 #include <lvgl.h>
 #include <stdbool.h>
 
 /* Shared move flag, set by gesture_event_cb() or create_buttons() callbacks */
 int8_t direction_flag = 0;
 
 int main(void)
 {
     const struct device *dev = DEVICE_DT_GET(DT_CHOSEN(zephyr_display));
     if (!device_is_ready(dev)) {
         return 0;
     }
     display_blanking_off(dev);
 
     /* Let LVGL finish its initial timers */
     lv_timer_handler();
 
     /* Build the UI */
     lv_obj_t *scr = lv_scr_act();
     create_board(scr);
 #ifdef CONFIG_2048_USE_BUTTONS_TO_MOVE
     create_buttons(scr);
 #endif
     lv_obj_add_event_cb(scr, gesture_event_cb, LV_EVENT_GESTURE, NULL);
 
     /* Initialize game logic and first draw */
     init_game();
     update_ui();
 
     /* Main loop */
     while (1) {
         if (direction_flag) {
             bool moved = false;
             switch (direction_flag) {
             case 1: moved = move_left();  break;
             case 2: moved = move_up();    break;
             case 3: moved = move_right(); break;
             case 4: moved = move_down();  break;
             }
             if (moved) {
                 spawn_tile();
                 update_ui();
                 if (!can_move()) {
                     lv_obj_t *msg = lv_label_create(scr);
                     lv_label_set_text(msg, "Game Over");
                     lv_obj_center(msg);
                 }
             }
             direction_flag = 0;
         }
         lv_timer_handler();
         k_sleep(K_MSEC(50));
     }
 
     return 0;
 }
 
```

## inc/config.h
```c
/* include/config.h
 *
 * Common configuration defines for the Zephyr‑2048 project
 * 
 */

 #ifndef CONFIG_H
 #define CONFIG_H
 
 /* Grid dimensions */
 #define GRID_SIZE       4
 #define CELL_MARGIN     5   /* px between cells */
 
 /*
  * Choose how much of the screen the board occupies.
  * Set CONFIG_2048_USE_BUTTONS_TO_MOVE=y in prj.conf to enable on‑screen buttons.
  */
 #ifdef CONFIG_2048_USE_BUTTONS_TO_MOVE
 #  define BOARD_SCALE    0.80f  /* 80% of screen when using on‑screen buttons */
 #else
 #  define BOARD_SCALE    0.94f  /* 94% of screen when using swipe only */
 #endif
 
 /*
  * Button overlap and symbol positioning
  * (only used if CONFIG_2048_USE_BUTTONS_TO_MOVE is enabled)
  */
 #define BTN_OVERLAP         10    /* px buttons extend over the grid edge */
 #define SYMBOL_PAD          14    /* px from inner board edge to arrow */
 #define SYMBOL_ADJUSTMENT   14    /* additional px adj. for top/bottom arrows */
 
 #endif /* CONFIG_H */
 
```

## inc/game.h
```c
#ifndef GAME_H
#define GAME_H

/**
 * @file game.h
 * @brief Game logic API for the Zephyr‑2048 project.
 *
 * Implements the core 2048 mechanics: initialization, moves, spawning, and game‑over check.
 */

#include "config.h"
#include <stdbool.h>

/**
 * @brief The current board state.
 *
 * A 4×4 array where 0 represents an empty cell, and any other value
 * represents a tile of that value.
 */
extern int grid[GRID_SIZE][GRID_SIZE];

/**
 * @brief Reset the board and spawn two initial tiles.
 *
 * Clears the grid to all zeros and then randomly places two tiles
 * (2 or, with 10% chance, 4) on empty cells.
 */
void init_game(void);

/**
 * @brief Add one new tile (2 or 4) at a random empty position.
 *
 * Chooses a random empty cell and places a 2 (90% chance) or 4 (10% chance).
 */
void spawn_tile(void);

/**
 * @brief Shift and merge all rows to the left.
 *
 * Compresses non-zero tiles leftward, merges equal adjacent tiles into one
 * tile of double value, and compresses again.
 *
 * @return true if any tile moved or merged, false otherwise.
 */
bool move_left(void);

/**
 * @brief Shift and merge all rows to the right.
 *
 * Mirrors the move_left algorithm: reverses each row, applies move_left,
 * then reverses back.
 *
 * @return true if any tile moved or merged, false otherwise.
 */
bool move_right(void);

/**
 * @brief Shift and merge all columns upward.
 *
 * Transposes the grid, applies move_left, then transposes back.
 *
 * @return true if any tile moved or merged, false otherwise.
 */
bool move_up(void);

/**
 * @brief Shift and merge all columns downward.
 *
 * Transposes the grid, applies move_right, then transposes back.
 *
 * @return true if any tile moved or merged, false otherwise.
 */
bool move_down(void);

/**
 * @brief Check if any move is possible.
 *
 * Scans for any empty cell (value 0) or any pair of equal adjacent tiles
 * horizontally or vertically.
 *
 * @return true if at least one move remains possible, false if the game is over.
 */
bool can_move(void);

#endif /* GAME_H */
```

## inc/input.h
```c
/* include/input.h
 *
 * Input handling API for the Zephyr‑2048 project.
 * Supports swipe gestures and optional on‑screen buttons.
 */

 #ifndef INPUT_H
 #define INPUT_H
 
 #include "config.h"
 #include <lvgl.h>
 
 /**
  * @brief LVGL gesture event callback to handle swipe moves.
  *
  * Attach this to the active screen with:
  *     lv_obj_add_event_cb(scr, gesture_event_cb, LV_EVENT_GESTURE, NULL);
  *
  * It reads the last gesture direction from the active input device
  * and sets the internal direction_flag (1=left,2=up,3=right,4=down).
  *
  * @param e Pointer to the LVGL event containing gesture information.
  */
 void gesture_event_cb(lv_event_t *e);
 
 #ifdef CONFIG_2048_USE_BUTTONS_TO_MOVE
 
 /**
  * @brief Create transparent edge buttons for tap-based movement.
  *
  * Each button spans one side of the board (overlapping it by BTN_OVERLAP)
  * and uses an LV_SYMBOL_* arrow. Touching a button sets the move direction.
  *
  * @param parent LVGL parent object (typically lv_scr_act()) to which buttons are added.
  */
 void create_buttons(lv_obj_t *parent);
 
 #endif /* CONFIG_2048_USE_BUTTONS_TO_MOVE */
 
 #endif /* INPUT_H */
 
```

## inc/ui.h
```c
/* include/ui.h
 *
 * UI API for the Zephyr‑2048 project.
 * Handles creation of the LVGL board, tile coloring, and UI updates.
 */

 #ifndef UI_H
 #define UI_H
 
 #include "config.h"
 #include <lvgl.h>
 
 /**
  * @brief Get the background color for a tile of value @p v.
  *
  * Returns the standard 2048 hex color for values 0,2,4,…,2048,
  * or a default dark color for values >2048.
  *
  * @param v The tile value (0 = empty, otherwise power of two).
  * @return An lv_color_t representing the tile background.
  */
 lv_color_t get_bg_color(int v);
 
 /**
  * @brief Get the text color for a tile of value @p v.
  *
  * Returns a dark text color for small tiles (2,4) and light
  * for larger ones, matching the classic 2048 palette.
  *
  * @param v The tile value.
  * @return An lv_color_t for the label text.
  */
 lv_color_t get_text_color(int v);
 
 /**
  * @brief Create and lay out the 4×4 grid of cells.
  *
  * Allocates a parent “board” object (centered and scaled by BOARD_SCALE)
  * then creates GRID_SIZE × GRID_SIZE child cells with margins of CELL_MARGIN.
  * Each cell holds an empty label initially.
  *
  * @param parent The LVGL object (e.g. lv_scr_act()) to attach the board to.
  */
 void create_board(lv_obj_t *parent);
 
 /**
  * @brief Refresh all cell labels and backgrounds from the game state.
  *
  * Reads the global `grid[GRID_SIZE][GRID_SIZE]` array and for each cell:
  *  - Sets its background color via get_bg_color()
  *  - Sets its label text to the tile value (or empty)
  *  - Sets its label text color via get_text_color()
  */
 void update_ui(void);
 
 #endif /* UI_H */
 
```

## src/game.c
```c
/* src/game.c
 *
 * Implements the core 2048 game logic:
 * initialization, tile spawning, moves (left/right/up/down), and game‑over check.
 */

 #include "config.h"
 #include "game.h"
 #include <string.h>
 #include <zephyr/random/random.h>
 
 int grid[GRID_SIZE][GRID_SIZE];
 
 /**
  * @brief Reset the board and spawn two initial tiles.
  */
 void init_game(void)
 {
     /* Clear grid */
     memset(grid, 0, sizeof(grid));
 
     /* Place two initial tiles */
     for (int i = 0; i < 2; i++) {
         int empties = 0;
         int coords[GRID_SIZE * GRID_SIZE][2];
 
         /* Collect empty cell coordinates */
         for (int r = 0; r < GRID_SIZE; r++) {
             for (int c = 0; c < GRID_SIZE; c++) {
                 if (grid[r][c] == 0) {
                     coords[empties][0] = r;
                     coords[empties][1] = c;
                     empties++;
                 }
             }
         }
 
         if (empties == 0) {
             return;
         }
 
         /* Pick one at random */
         int idx = sys_rand32_get() % empties;
         /* 90% chance 2, 10% chance 4 */
         grid[coords[idx][0]][coords[idx][1]] =
             (sys_rand32_get() % 10 == 0) ? 4 : 2;
     }
 }
 
 /**
  * @brief Spawn one new tile (2 or 4) at a random empty position.
  */
 void spawn_tile(void)
 {
     int empties = 0;
     int coords[GRID_SIZE * GRID_SIZE][2];
 
     /* Collect empty cell coordinates */
     for (int r = 0; r < GRID_SIZE; r++) {
         for (int c = 0; c < GRID_SIZE; c++) {
             if (grid[r][c] == 0) {
                 coords[empties][0] = r;
                 coords[empties][1] = c;
                 empties++;
             }
         }
     }
 
     if (empties == 0) {
         return;
     }
 
     /* Pick one at random */
     int idx = sys_rand32_get() % empties;
     /* 90% chance 2, 10% chance 4 */
     grid[coords[idx][0]][coords[idx][1]] =
         (sys_rand32_get() % 10 == 0) ? 4 : 2;
 }
 
 /**
  * @brief Shift and merge all rows to the left.
  *
  * @return true if any tile moved or merged, false otherwise.
  */
 bool move_left(void)
 {
     bool moved = false;
 
     for (int r = 0; r < GRID_SIZE; r++) {
         int tmp[GRID_SIZE] = {0};
         int cnt = 0;
 
         /* Compress non-zero tiles into tmp[] */
         for (int c = 0; c < GRID_SIZE; c++) {
             if (grid[r][c] != 0) {
                 tmp[cnt++] = grid[r][c];
             }
         }
 
         /* Merge adjacent equals */
         for (int i = 0; i < cnt - 1; i++) {
             if (tmp[i] && tmp[i] == tmp[i + 1]) {
                 tmp[i] *= 2;
                 tmp[i + 1] = 0;
                 moved = true;
             }
         }
 
         /* Rebuild the row and detect any movement */
         int final[GRID_SIZE] = {0};
         int j = 0;
         for (int i = 0; i < GRID_SIZE; i++) {
             if (tmp[i] != 0) {
                 final[j++] = tmp[i];
             }
         }
         for (int c = 0; c < GRID_SIZE; c++) {
             if (grid[r][c] != final[c]) {
                 moved = true;
                 grid[r][c] = final[c];
             }
         }
     }
 
     return moved;
 }
 
 /**
  * @brief Shift and merge all rows to the right.
  *
  * @return true if any tile moved or merged, false otherwise.
  */
 bool move_right(void)
 {
     /* Reverse each row, move left, reverse back */
     for (int r = 0; r < GRID_SIZE; r++) {
         for (int c = 0; c < GRID_SIZE / 2; c++) {
             int t = grid[r][c];
             grid[r][c] = grid[r][GRID_SIZE - 1 - c];
             grid[r][GRID_SIZE - 1 - c] = t;
         }
     }
 
     bool moved = move_left();
 
     for (int r = 0; r < GRID_SIZE; r++) {
         for (int c = 0; c < GRID_SIZE / 2; c++) {
             int t = grid[r][c];
             grid[r][c] = grid[r][GRID_SIZE - 1 - c];
             grid[r][GRID_SIZE - 1 - c] = t;
         }
     }
 
     return moved;
 }
 
 /**
  * @brief Shift and merge all columns upward.
  *
  * @return true if any tile moved or merged, false otherwise.
  */
 bool move_up(void)
 {
     /* Transpose, move left, transpose back */
     for (int r = 0; r < GRID_SIZE; r++) {
         for (int c = r + 1; c < GRID_SIZE; c++) {
             int t = grid[r][c];
             grid[r][c] = grid[c][r];
             grid[c][r] = t;
         }
     }
 
     bool moved = move_left();
 
     for (int r = 0; r < GRID_SIZE; r++) {
         for (int c = r + 1; c < GRID_SIZE; c++) {
             int t = grid[r][c];
             grid[r][c] = grid[c][r];
             grid[c][r] = t;
         }
     }
 
     return moved;
 }
 
 /**
  * @brief Shift and merge all columns downward.
  *
  * @return true if any tile moved or merged, false otherwise.
  */
 bool move_down(void)
 {
     /* Transpose, move right, transpose back */
     for (int r = 0; r < GRID_SIZE; r++) {
         for (int c = r + 1; c < GRID_SIZE; c++) {
             int t = grid[r][c];
             grid[r][c] = grid[c][r];
             grid[c][r] = t;
         }
     }
 
     bool moved = move_right();
 
     for (int r = 0; r < GRID_SIZE; r++) {
         for (int c = r + 1; c < GRID_SIZE; c++) {
             int t = grid[r][c];
             grid[r][c] = grid[c][r];
             grid[c][r] = t;
         }
     }
 
     return moved;
 }
 
 /**
  * @brief Check if any move is possible.
  *
  * Scans for any empty cell or any pair of equal adjacent tiles.
  *
  * @return true if at least one move remains possible.
  */
 bool can_move(void)
 {
     for (int r = 0; r < GRID_SIZE; r++) {
         for (int c = 0; c < GRID_SIZE; c++) {
             if (grid[r][c] == 0) {
                 return true;
             }
             if (c < GRID_SIZE - 1 && grid[r][c] == grid[r][c + 1]) {
                 return true;
             }
             if (r < GRID_SIZE - 1 && grid[r][c] == grid[r + 1][c]) {
                 return true;
             }
         }
     }
     return false;
 }
 
```

## src/input.c
```c
/* src/input.c
 *
 * Implements input handling for the Zephyr‑2048 project.
 * Supports swipe gestures and optional on‑screen buttons.
 */

 #include "config.h"
 #include "input.h"
 #include <lvgl.h>
 #include <stdint.h>
 
 /* direction_flag is defined in main.c */
 extern int8_t direction_flag;
 
 void gesture_event_cb(lv_event_t *e)
 {
     /* Get the active input device and query its last gesture */
     lv_indev_t *indev = lv_indev_get_act();
     lv_dir_t dir = lv_indev_get_gesture_dir(indev);
 
     switch (dir) {
     case LV_DIR_LEFT:   direction_flag = 1; break;
     case LV_DIR_TOP:    direction_flag = 2; break;
     case LV_DIR_RIGHT:  direction_flag = 3; break;
     case LV_DIR_BOTTOM: direction_flag = 4; break;
     default: break;
     }
 }
 
 #ifdef CONFIG_2048_USE_BUTTONS_TO_MOVE
 
 /* LVGL animation callback to scale button */
 static void zoom_anim_cb(void *var, int32_t v)
 {
     lv_obj_set_style_transform_zoom((lv_obj_t *)var, v, 0);
 }
 
 /* Animate button press */
 static void animate_button(lv_obj_t *btn)
 {
     lv_anim_t a;
     lv_anim_init(&a);
     lv_anim_set_var(&a, btn);
     lv_anim_set_exec_cb(&a, zoom_anim_cb);
     lv_anim_set_values(&a, 256, 218); /* 100% to ~85% */
     lv_anim_set_time(&a, 100);
     lv_anim_set_playback_time(&a, 100);
     lv_anim_set_playback_delay(&a, 0);
     lv_anim_start(&a);
 }
 
 /* Direction button event: animate and set flag */
 static void btn_event_cb(lv_event_t *e)
 {
     lv_obj_t *btn = lv_event_get_target(e);
     animate_button(btn);
     direction_flag = (int)(intptr_t)lv_event_get_user_data(e);
 }
 
 /* Create transparent edge buttons for tap-based movement */
 void create_buttons(lv_obj_t *parent)
 {
     /* Compute screen and board geometry */
     lv_disp_t *disp = lv_disp_get_default();
     int scr_w   = lv_disp_get_hor_res(disp);
     int scr_h   = lv_disp_get_ver_res(disp);
     int board_w = (int)(scr_w * BOARD_SCALE);
     int board_h = (int)(scr_h * BOARD_SCALE);
 
     /* Margins around the board */
     int margin_h = (scr_w - board_w) / 2;
     int margin_v = (scr_h - board_h) / 2;
 
     /* All buttons get the same “thickness”, overlapping the board */
     int thickness = (margin_h > margin_v ? margin_h : margin_v) + BTN_OVERLAP;
 
     lv_obj_t *btn;
     lv_obj_t *label;
 
     /* Helper to fully hide a button’s visuals */
     #define MAKE_BTN_INVISIBLE(b)                            \
         do {                                                \
             lv_obj_set_style_bg_opa(b,    LV_OPA_TRANSP, 0); \
             lv_obj_set_style_border_opa(b,LV_OPA_TRANSP, 0); \
             lv_obj_set_style_outline_opa(b,LV_OPA_TRANSP, 0); \
             lv_obj_set_style_shadow_opa(b, LV_OPA_TRANSP, 0); \
             lv_obj_set_style_border_width(b,  0, 0);        \
             lv_obj_set_style_outline_width(b, 0, 0);        \
             lv_obj_set_style_shadow_width(b,  0, 0);        \
             lv_obj_set_style_radius(b,        0, 0);        \
             lv_obj_set_style_pad_all(b,       0, 0);        \
         } while (0)
 
     /* ─── Up ─────────────────────────────────────────────────── */
     btn = lv_btn_create(parent);
     lv_obj_set_size(btn, board_w, thickness);
     lv_obj_align(btn, LV_ALIGN_TOP_MID, 0, 0);
     MAKE_BTN_INVISIBLE(btn);
     lv_obj_add_event_cb(btn, btn_event_cb, LV_EVENT_CLICKED, (void*)(intptr_t)2);
     label = lv_label_create(btn);
     lv_label_set_text(label, LV_SYMBOL_UP);
     lv_obj_set_style_text_color(label, lv_color_hex(0x000000), 0);
     lv_obj_align(label, LV_ALIGN_BOTTOM_MID, 0, -SYMBOL_PAD - SYMBOL_ADJUSTMENT);
 
     /* ─── Down ───────────────────────────────────────────────── */
     btn = lv_btn_create(parent);
     lv_obj_set_size(btn, board_w, thickness);
     lv_obj_align(btn, LV_ALIGN_BOTTOM_MID, 0, 0);
     MAKE_BTN_INVISIBLE(btn);
     lv_obj_add_event_cb(btn, btn_event_cb, LV_EVENT_CLICKED, (void*)(intptr_t)4);
     label = lv_label_create(btn);
     lv_label_set_text(label, LV_SYMBOL_DOWN);
     lv_obj_set_style_text_color(label, lv_color_hex(0x000000), 0);
     lv_obj_align(label, LV_ALIGN_TOP_MID, 0, SYMBOL_PAD + SYMBOL_ADJUSTMENT);
 
     /* ─── Left ───────────────────────────────────────────────── */
     btn = lv_btn_create(parent);
     lv_obj_set_size(btn, thickness, board_h);
     lv_obj_align(btn, LV_ALIGN_LEFT_MID, 0, 0);
     MAKE_BTN_INVISIBLE(btn);
     lv_obj_add_event_cb(btn, btn_event_cb, LV_EVENT_CLICKED, (void*)(intptr_t)1);
     label = lv_label_create(btn);
     lv_label_set_text(label, LV_SYMBOL_LEFT);
     lv_obj_set_style_text_color(label, lv_color_hex(0x000000), 0);
     lv_obj_align(label, LV_ALIGN_RIGHT_MID, -SYMBOL_PAD, 0);
 
     /* ─── Right ─────────────────────────────────────────────── */
     btn = lv_btn_create(parent);
     lv_obj_set_size(btn, thickness, board_h);
     lv_obj_align(btn, LV_ALIGN_RIGHT_MID, 0, 0);
     MAKE_BTN_INVISIBLE(btn);
     lv_obj_add_event_cb(btn, btn_event_cb, LV_EVENT_CLICKED, (void*)(intptr_t)3);
     label = lv_label_create(btn);
     lv_label_set_text(label, LV_SYMBOL_RIGHT);
     lv_obj_set_style_text_color(label, lv_color_hex(0x000000), 0);
     lv_obj_align(label, LV_ALIGN_LEFT_MID, SYMBOL_PAD, 0);
 
     #undef MAKE_BTN_INVISIBLE
 }
 
 #endif /* CONFIG_2048_USE_BUTTONS_TO_MOVE */
 
```

## src/ui.c
```c
/* src/ui.c
 *
 * Implements UI API for the Zephyr‑2048 project:
 * - get_bg_color(), get_text_color()
 * - create_board(), update_ui()
 */

 #include "config.h"
 #include "ui.h"
 #include "game.h"
 #include <lvgl.h>
 #include <stdio.h>
 
 static lv_obj_t *cells[GRID_SIZE][GRID_SIZE];
 
 /**
  * @brief Get the background color for a tile of value v.
  */
 lv_color_t get_bg_color(int v)
 {
     switch (v) {
     case 0:    return lv_color_hex(0xCDC1B4);
     case 2:    return lv_color_hex(0xEEE4DA);
     case 4:    return lv_color_hex(0xEDE0C8);
     case 8:    return lv_color_hex(0xF2B179);
     case 16:   return lv_color_hex(0xF59563);
     case 32:   return lv_color_hex(0xF67C5F);
     case 64:   return lv_color_hex(0xF65E3B);
     case 128:  return lv_color_hex(0xEDCF72);
     case 256:  return lv_color_hex(0xEDCC61);
     case 512:  return lv_color_hex(0xEDC850);
     case 1024: return lv_color_hex(0xEDC53F);
     case 2048: return lv_color_hex(0xEDC22E);
     default:   return lv_color_hex(0x3C3A32); /* >2048 */
     }
 }
 
 /**
  * @brief Get the text color for a tile of value v.
  */
 lv_color_t get_text_color(int v)
 {
     /* dark text for 2 and 4, light for larger tiles */
     return (v == 2 || v == 4)
            ? lv_color_hex(0x776E65)
            : lv_color_hex(0xF9F6F2);
 }
 
 /**
  * @brief Create and lay out the 4×4 grid of cells.
  */
 void create_board(lv_obj_t *parent)
 {
     lv_disp_t *disp = lv_disp_get_default();
     int scr_w = lv_disp_get_hor_res(disp);
     int scr_h = lv_disp_get_ver_res(disp);
     int board_w = (int)(scr_w * BOARD_SCALE);
     int board_h = (int)(scr_h * BOARD_SCALE);
     int cell_w = (board_w - (GRID_SIZE + 1) * CELL_MARGIN) / GRID_SIZE;
     int cell_h = (board_h - (GRID_SIZE + 1) * CELL_MARGIN) / GRID_SIZE;
 
     /* board background */
     lv_obj_t *board = lv_obj_create(parent);
     lv_obj_set_size(board, board_w, board_h);
     lv_obj_center(board);
     lv_obj_set_style_bg_color(board, lv_color_hex(0xBBADA0), 0);
     lv_obj_set_style_radius(board, 10, 0);
     lv_obj_set_style_pad_all(board, 0, 0);
 
     /* create each cell */
     for (int r = 0; r < GRID_SIZE; r++) {
         for (int c = 0; c < GRID_SIZE; c++) {
             lv_obj_t *cell = lv_obj_create(board);
             lv_obj_set_size(cell, cell_w, cell_h);
             lv_obj_set_pos(cell,
                 CELL_MARGIN + c * (cell_w + CELL_MARGIN),
                 CELL_MARGIN + r * (cell_h + CELL_MARGIN));
             lv_obj_set_style_bg_color(cell, get_bg_color(0), 0);
             lv_obj_set_style_radius(cell, 5, 0);
             lv_obj_set_style_border_width(cell, 0, 0);
 
             /* label in center */
             lv_obj_t *lbl = lv_label_create(cell);
             lv_obj_set_style_text_align(lbl, LV_TEXT_ALIGN_CENTER, 0);
             lv_obj_set_style_text_font(lbl, &lv_font_montserrat_22, 0);
             lv_obj_center(lbl);
 
             cells[r][c] = lbl;
         }
     }
 }
 
 /**
  * @brief Refresh all cell labels and backgrounds from the game state.
  */
 void update_ui(void)
 {
     char buf[8];
 
     for (int r = 0; r < GRID_SIZE; r++) {
         for (int c = 0; c < GRID_SIZE; c++) {
             int v = grid[r][c];
             lv_obj_t *lbl  = cells[r][c];
             lv_obj_t *cell = lv_obj_get_parent(lbl);
 
             /* update background and text color */
             lv_obj_set_style_bg_color(cell, get_bg_color(v), 0);
             lv_obj_set_style_text_color(lbl, get_text_color(v), 0);
 
             /* update number or clear */
             if (v) {
                 snprintf(buf, sizeof(buf), "%d", v);
             } else {
                 buf[0] = '\0';
             }
             lv_label_set_text(lbl, buf);
         }
     }
 }
 
```
